## conf/machine/odroid-xu.conf
```bitbake
#-----------------------------------------------------------------------------
#@TYPE: Machine
#@NAME: ODROID-XU (Exynos 5 Octa)
#@DESCRIPTION: Machine configuration for the ODROID-XU by hardkernel
#-----------------------------------------------------------------------------

TARGET_ARCH = "arm"

PREFERRED_PROVIDER_virtual/kernel ?= "linux-hardkernel-odroidxu"

KERNEL_IMAGETYPE = "uImage"
IMAGE_FSTYPES += "tar.gz"

require conf/machine/include/tune-cortexa15.inc
```
